# MIMXRT1064 register map
Vendor: nxp.com; File version: 1.0
MIMXRT1064DVL6A
CPU: CM7 r0p1, little endian, MPU, FPU, VTOR, 4 interrupt priority bits
Registers are 32-bit, read-write, reset 0x0 unless marked. A register's access mark holds for its fields unless they carry their own. Offsets are from the block's base; lines under a group give offsets from that group; [hi:lo] are bit positions; {n}, {i} and the like mark numbered series; 'fields as' and 'values as' point back to an identical list; <NAME> marks a mode.

## Memory map
0x4007C000 AIPSTZ1 size 0x54 — AIPSTZ Control Registers
0x40080000 DCDC size 0x10
0x40084000 PIT size 0x140
0x40094000 CMP1 size 0x6 — High-Speed Comparator (CMP), Voltage Reference (VREF) Digital-to-Analog Converter (DAC), and Analog Mux (ANMUX)
0x40094008 CMP2 size 0x6 — High-Speed Comparator (CMP), Voltage Reference (VREF) Digital-to-Analog Converter (DAC), and Analog Mux (ANMUX)
0x40094010 CMP3 size 0x6 — High-Speed Comparator (CMP), Voltage Reference (VREF) Digital-to-Analog Converter (DAC), and Analog Mux (ANMUX)
0x40094018 CMP4 size 0x6 — High-Speed Comparator (CMP), Voltage Reference (VREF) Digital-to-Analog Converter (DAC), and Analog Mux (ANMUX)
0x400A4000 IOMUXC_SNVS_GPR size 0x10 — IOMUXC
0x400A8000 IOMUXC_SNVS size 0x24
0x400AC000 IOMUXC_GPR size 0x8C
0x400B0000 FLEXRAM size 0x1000
0x400B4000 EWM size 0x6
0x400B8000 WDOG1 size 0xA — WDOG
0x400BC000 RTWDOG size 0x10 — WDOG
0x400C0000 GPIO5 size 0x90 — GPIO
0x400C4000 ADC1 size 0x5C — Analog-to-Digital Converter
0x400C8000 ADC2 size 0x5C — Analog-to-Digital Converter
0x400CC000 TRNG size 0xF8
0x400D0000 WDOG2 size 0xA — WDOG
0x400D4000 SNVS size 0xC00
0x400D8000 CCM_ANALOG size 0x180
0x400D8000 PMU size 0x180
0x400D8000 TEMPMON size 0x2A0 — Temperature Monitor
0x400D8000 USB_ANALOG size 0x264
0x400D8000 XTALOSC24M size 0x2D0
0x400D9000 USBPHY1 size 0x84 — USBPHY Register Reference Index
0x400DA000 USBPHY2 size 0x84 — USBPHY Register Reference Index
0x400DC000 CSU size 0x35C — CSU registers
0x400E0000 TSC size 0x84 — Touch Screen Controller
0x400E8000 DMA0 size 0x1400 — DMA
0x400EC000 DMAMUX size 0x80 — DMA_CH_MUX
0x400F4000 GPC size 0x3C
0x400F4000 PGC size 0x2B0
0x400F8000 SRC size 0x48
0x400FC000 CCM size 0x8C
0x4017C000 AIPSTZ2 size 0x54 — AIPSTZ Control Registers
0x40180000 ROMC size 0x20C
{0x40180000+0x4000*n} LPUART{n} size 0x30 (n=1..8) — LPUART
0x401AC000 FLEXIO1 size 0x790 — FLEXIO
0x401B0000 FLEXIO2 size 0x790 — FLEXIO
0x401B8000 GPIO1 size 0x90 — GPIO
0x401BC000 GPIO2 size 0x90 — GPIO
0x401C0000 GPIO3 size 0x90 — GPIO
0x401C4000 GPIO4 size 0x90 — GPIO
0x401D0000 CAN1 size 0x9E4 — FLEXCAN
0x401D4000 CAN2 size 0x9E4 — FLEXCAN
0x401D8000 CAN3 size 0x3200 — CAN
0x401DC000 TMR1 size 0x7A — Quad Timer
0x401E0000 TMR2 size 0x7A — Quad Timer
0x401E4000 TMR3 size 0x7A — Quad Timer
0x401E8000 TMR4 size 0x7A — Quad Timer
0x401EC000 GPT1 size 0x28 — GPT
0x401F0000 GPT2 size 0x28 — GPT
0x401F4000 OCOTP size 0x8F4
0x401F8000 IOMUXC size 0x790
0x401FC000 KPP size 0x8 — KPP Registers
0x4027C000 AIPSTZ3 size 0x54 — AIPSTZ Control Registers
0x402A4000 FLEXSPI2 size 0x400 — FlexSPI
0x402A8000 FLEXSPI size 0x400
0x402B4000 PXP size 0x444 — PXP v2.0 Register Reference Index
0x402B8000 LCDIF size 0xB44 — LCDIF Register Reference Index
0x402BC000 CSI size 0x50
0x402C0000 USDHC1 size 0xD0 — uSDHC
0x402C4000 USDHC2 size 0xD0 — uSDHC
0x402D4000 ENET2 size 0x628 — Ethernet MAC-NET Core
0x402D8000 ENET size 0x628 — Ethernet MAC-NET Core
0x402E0000 USB1 size 0x1E0 — USB
0x402E0000 USBNC1 size 0x81C — USB
0x402E0004 USBNC2 size 0x81C — USB
0x402E0200 USB2 size 0x1E0 — USB
0x402F0000 SEMC size 0x100
0x402FC000 DCP size 0x434 — DCP register reference index
0x4037C000 AIPSTZ4 size 0x54 — AIPSTZ Control Registers
0x40380000 SPDIF size 0x54
0x40384000 SAI1 size 0xE4 — I2S
0x40388000 SAI2 size 0xE4 — I2S
0x4038C000 SAI3 size 0xE4 — I2S
0x40394000 LPSPI1 size 0x78 — LPSPI
0x40398000 LPSPI2 size 0x78 — LPSPI
0x4039C000 LPSPI3 size 0x78 — LPSPI
0x403A0000 LPSPI4 size 0x78 — LPSPI
0x403B0000 ADC_ETC size 0x150
0x403B4000 AOI1 size 0x10 — AND/OR/INVERT module
0x403B8000 AOI2 size 0x10 — AND/OR/INVERT module
0x403BC000 XBARA1 size 0x88 — Crossbar Switch
0x403C0000 XBARB2 size 0x10 — Crossbar Switch
0x403C4000 XBARB3 size 0x10 — Crossbar Switch
0x403C8000 ENC1 size 0x28 — Quadrature Decoder
0x403CC000 ENC2 size 0x28 — Quadrature Decoder
0x403D0000 ENC3 size 0x28 — Quadrature Decoder
0x403D4000 ENC4 size 0x28 — Quadrature Decoder
0x403DC000 PWM1 size 0x196 — PWM
0x403E0000 PWM2 size 0x196 — PWM
0x403E4000 PWM3 size 0x196 — PWM
0x403E8000 PWM4 size 0x196 — PWM
0x403EC000 BEE size 0x48 — Bus Encryption Engine
0x403F0000 LPI2C1 size 0x174 — LPI2C
0x403F4000 LPI2C2 size 0x174 — LPI2C
0x403F8000 LPI2C3 size 0x174 — LPI2C
0x403FC000 LPI2C4 size 0x174 — LPI2C
0x42000000 GPIO6 size 0x90 — GPIO
0x42004000 GPIO7 size 0x90 — GPIO
0x42008000 GPIO8 size 0x90 — GPIO
0x4200C000 GPIO9 size 0x90 — GPIO
0x42020000 FLEXIO3 size 0x790 — FLEXIO
0xE000E000 SystemControl size 0xFAC — System Control Block
0xE000E100 NVIC size 0xE04 — Nested Vectored Interrupt Controller

## Interrupts
{n} DMA{n}_DMA{n+16} (DMA0, NVIC) (n=0..15)
16 DMA_ERROR (DMA0, NVIC)
17 CTI0_ERROR (NVIC)
18 CTI1_ERROR (NVIC)
19 CORE (NVIC)
{n+19} LPUART{n} (LPUART{n}, NVIC) (n=1..8)
28 LPI2C1 (LPI2C1, NVIC)
29 LPI2C2 (LPI2C2, NVIC)
30 LPI2C3 (LPI2C3, NVIC)
31 LPI2C4 (LPI2C4, NVIC)
32 LPSPI1 (LPSPI1, NVIC)
33 LPSPI2 (LPSPI2, NVIC)
34 LPSPI3 (LPSPI3, NVIC)
35 LPSPI4 (LPSPI4, NVIC)
36 CAN1 (CAN1, NVIC)
37 CAN2 (CAN2, NVIC)
38 FLEXRAM (FLEXRAM, NVIC)
39 KPP (KPP, NVIC)
40 TSC_DIG (TSC, NVIC)
41 GPR_IRQ (NVIC)
42 LCDIF (LCDIF, NVIC)
43 CSI (CSI, NVIC)
44 PXP (PXP, NVIC)
45 WDOG2 (WDOG2, NVIC)
46 SNVS_HP_WRAPPER (SNVS, NVIC)
47 SNVS_HP_WRAPPER_TZ (SNVS, NVIC)
48 SNVS_LP_WRAPPER (SNVS, NVIC)
49 CSU (CSU, NVIC)
50 DCP (DCP, NVIC)
51 DCP_VMI (DCP, NVIC)
52 Reserved68 (NVIC)
53 TRNG (TRNG, NVIC)
54 SJC (NVIC)
55 BEE (BEE, NVIC)
56 SAI1 (SAI1, NVIC)
57 SAI2 (SAI2, NVIC)
58 SAI3_RX (SAI3, NVIC)
59 SAI3_TX (SAI3, NVIC)
60 SPDIF (SPDIF, NVIC)
61 PMU_EVENT (PMU, NVIC)
62 Reserved78 (NVIC)
63 TEMP_LOW_HIGH (TEMPMON, NVIC)
64 TEMP_PANIC (TEMPMON, NVIC)
65 USB_PHY1 (USBPHY1, NVIC)
66 USB_PHY2 (USBPHY2, NVIC)
67 ADC1 (ADC1, NVIC)
68 ADC2 (ADC2, NVIC)
69 DCDC (DCDC, NVIC)
70 Reserved86 (NVIC)
71 Reserved87 (NVIC)
{n+72} GPIO1_INT{n} (GPIO1, NVIC) (n=0..7)
80 GPIO1_Combined_0_15 (GPIO1, NVIC)
81 GPIO1_Combined_16_31 (GPIO1, NVIC)
82 GPIO2_Combined_0_15 (GPIO2, NVIC)
83 GPIO2_Combined_16_31 (GPIO2, NVIC)
84 GPIO3_Combined_0_15 (GPIO3, NVIC)
85 GPIO3_Combined_16_31 (GPIO3, NVIC)
86 GPIO4_Combined_0_15 (GPIO4, NVIC)
87 GPIO4_Combined_16_31 (GPIO4, NVIC)
88 GPIO5_Combined_0_15 (GPIO5, NVIC)
89 GPIO5_Combined_16_31 (GPIO5, NVIC)
90 FLEXIO1 (FLEXIO1, NVIC)
91 FLEXIO2 (FLEXIO2, NVIC)
92 WDOG1 (WDOG1, NVIC)
93 RTWDOG (RTWDOG, NVIC)
94 EWM (EWM, NVIC)
95 CCM_1 (CCM, NVIC)
96 CCM_2 (CCM, NVIC)
97 GPC (GPC, NVIC)
98 SRC (SRC, NVIC)
99 Reserved115 (NVIC)
100 GPT1 (GPT1, NVIC)
101 GPT2 (GPT2, NVIC)
102 PWM1_0 (PWM1, NVIC)
103 PWM1_1 (PWM1, NVIC)
104 PWM1_2 (PWM1, NVIC)
105 PWM1_3 (PWM1, NVIC)
106 PWM1_FAULT (PWM1, NVIC)
107 FLEXSPI2 (FLEXSPI2, NVIC)
108 FLEXSPI (FLEXSPI, NVIC)
109 SEMC (SEMC, NVIC)
110 USDHC1 (USDHC1, NVIC)
111 USDHC2 (USDHC2, NVIC)
112 USB_OTG2 (USB2, NVIC)
113 USB_OTG1 (USB1, NVIC)
114 ENET (ENET, NVIC)
115 ENET_1588_Timer (ENET, NVIC)
116 XBAR1_IRQ_0_1 (NVIC)
117 XBAR1_IRQ_2_3 (NVIC)
118 ADC_ETC_IRQ0 (ADC_ETC, NVIC)
119 ADC_ETC_IRQ1 (ADC_ETC, NVIC)
120 ADC_ETC_IRQ2 (ADC_ETC, NVIC)
121 ADC_ETC_ERROR_IRQ (ADC_ETC, NVIC)
122 PIT (PIT, NVIC)
123 ACMP1 (CMP1, NVIC)
124 ACMP2 (CMP2, NVIC)
125 ACMP3 (CMP3, NVIC)
126 ACMP4 (CMP4, NVIC)
127 Reserved143 (NVIC)
128 Reserved144 (NVIC)
129 ENC1 (ENC1, NVIC)
130 ENC2 (ENC2, NVIC)
131 ENC3 (ENC3, NVIC)
132 ENC4 (ENC4, NVIC)
133 TMR1 (TMR1, NVIC)
134 TMR2 (TMR2, NVIC)
135 TMR3 (TMR3, NVIC)
136 TMR4 (TMR4, NVIC)
137 PWM2_0 (PWM2, NVIC)
138 PWM2_1 (PWM2, NVIC)
139 PWM2_2 (PWM2, NVIC)
140 PWM2_3 (PWM2, NVIC)
141 PWM2_FAULT (PWM2, NVIC)
142 PWM3_0 (PWM3, NVIC)
143 PWM3_1 (PWM3, NVIC)
144 PWM3_2 (PWM3, NVIC)
145 PWM3_3 (PWM3, NVIC)
146 PWM3_FAULT (PWM3, NVIC)
147 PWM4_0 (PWM4, NVIC)
148 PWM4_1 (PWM4, NVIC)
149 PWM4_2 (PWM4, NVIC)
150 PWM4_3 (PWM4, NVIC)
151 PWM4_FAULT (PWM4, NVIC)
152 ENET2 (ENET2, NVIC)
153 ENET2_1588_Timer (ENET2, NVIC)
154 CAN3 (CAN3, NVIC)
155 Reserved171 (NVIC)
156 FLEXIO3 (FLEXIO3, NVIC)
157 GPIO6_7_8_9 (GPIO{n} (n=6..9), NVIC)

## Licence text in the file
Copyright 2016-2019 NXP All rights reserved. SPDX-License-Identifier: BSD-3-Clause
