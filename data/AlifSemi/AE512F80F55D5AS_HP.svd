# AE512F80F55D5AS_CM55_HP_View register map
Vendor: Alif Semiconductor; Series: E5; File version: 1.0
CPU: CM55 r1p0, selectable endian, MPU, FPU, double-precision FPU, DSP, VTOR, 8 interrupt priority bits, 1 SAU regions

## Further device data
features: package=WLCSP208 ioPins=128 sramSize=13.5 mramSize=5.5 ospiSize=1024 securityType=Enclave gpuType=2D GPU displayType=24b Parallel + MIPI DSI cameraType=8-16b Parallel + MIPI CSI-2 temp=-40,75 adc12=3,12 adc24=1,24 dac=2,12 cmp=4 timer=12,32 qec=4,32 i2c=4 i2s=4 can=1 eth=1,100000000 ospi=2 sdio=1,8 spi=4,50000000 uart=8,2500000 usbotg=1
books:
  https://alifsemi.com/download/ADTS0006 type=Datasheet title=E5 Datasheet
  https://alifsemi.com/download/AHRM0006 type=Hardware Reference Manual title=E5 Hardware Reference Manual
  https://alifsemi.com/download/ASRM0001 type=SWRM title=Software Reference Manual
boards:
  DevKit-E7 (Gen 2) vendor=AlifSemiconductor description=DevKit E7 (FBGA194)
    deviceIndex=0 Dvendor=Alif Semiconductor:165 Dname=AE722F80F55D5LS
    deviceIndex=0 Dvendor=Alif Semiconductor:165 Dname=AE*L?
    adapter=JTAG/SW connector=20-pin Arm Coresight JTAG Connector (1.27 mm)
    adapter=JTAG/SW connector=10-pin Arm Coresight JTAG Connector (1.27 mm)
    type=XTAL n=38400000
    type=XTAL n=32768
    type=PWR n=4.75 m=5.25
    CR2032 Battery for RTC and VBATT peripherals type=Batt n=1
    type=Curr n=0.6 m=1
    32MB Octal SPI Hyper PSRAM type=RAM n=1
    32MB Octal SPI Flash type=ROM n=1
    Micro SD Card Holder type=MemCard n=2
    Digital IOs on 2 x 20 pin header (2.54 mm pitch) type=DIO n=30
    Digital IOs on 2 x 20 pin header (2.54 mm pitch) 1.8V/3.3V/5.0V type=DIO n=32
    Digital IOs on 2 x 20 pin header (2.54 mm pitch) for Parallel Camera or Display type=DIO n=32
    24 x Analog IOs and 8 x Digital IOs on 2 x 20 pin header (2.54 mm pitch) type=AIO n=32
    High-Speed USB Device, Micro-AB receptacle type=USB n=1
    High-Speed USB Device, Micro-AB receptacle, PGM interface via USB-to-UART bridge type=USB n=1
    RJ-45 receptacle 10/100 Ethernet type=ETH n=1 m=100000000
    TRS Audio Line-Out Jack type=LineOut n=1
    2 x 8 pin header for MIKROE Click Module type=ConnOther n=1
    GNSS type=ConnOther n=1
    3-axis Digital Accelerometer in ICM-42670-P type=Accelerometer n=1
    3-axis Digital Gyroscope in ICM-42670-P type=Gyro n=1
    3-axis Digital Accelerometer in BMI323 type=Accelerometer n=1
    3-axis Digital Gyroscope in BMI323 type=Gyro n=1
    16-bit Digital Temperature Sensor in BMI323 type=TempSens n=1
    2x I2S Digital MICs and 2x PDM Digital MICs type=SensOther n=4
    Potentiometer between 1.8 V and GND type=Poti n=1
    5-position Joystick type=Joystick n=1
    Reset push-button type=Button n=1
    Multicolor LEDs type=LED n=2
    2-Lane MIPI CSI Connector for OnSemi ARX3A0 0.3MP 1/10.3 MONO type=Camera n=1
    4.3-inch Color TFT LCD with Capacitive Touchscreen type=GLCD n=1 m=480.800
  AppKit-E3-AIML (Gen 2) vendor=AlifSemiconductor description=AppKit E3 (FBGA194)
    deviceIndex=0 Dvendor=Alif Semiconductor:165 Dname=AE302F80F55D5LE
    deviceIndex=0 Dvendor=Alif Semiconductor:165 Dname=AE*L?
    adapter=JTAG/SW connector=20-pin Arm Coresight JTAG Connector (1.27 mm)
    adapter=JTAG/SW connector=10-pin Arm Coresight JTAG Connector (1.27 mm)
    type=XTAL n=38400000
    type=XTAL n=32768
    type=PWR n=4.75 m=5.25
    2.1-mm DC barrel Jack, center positive type=PWRSock n=1
    type=Curr n=0.6 m=1
    32MB Octal SPI Hyper PSRAM type=RAM n=1
    32MB Octal SPI Flash type=ROM n=1
    Micro SD Card Holder type=MemCard n=2
    Digital IOs on 2 x 20 pin header (2.54 mm pitch) type=DIO n=30
    Digital IOs on 2 x 20 pin header (2.54 mm pitch) 1.8V/3.3V/5.0V type=DIO n=32
    Digital IOs on 2 x 20 pin header (2.54 mm pitch) for Parallel Camera or Display type=DIO n=32
    IOs for Click Module on 2 x 8 pin header (2.54 mm pitch) type=DIO n=12
    24 x Analog IOs and 8 x Digital IOs on 2 x 20 pin header (2.54 mm pitch) type=AIO n=32
    High-Speed USB Device, Micro-AB receptacle type=USB n=1
    High-Speed USB Device, Micro-AB receptacle, PGM interface via USB-to-UART bridge type=USB n=1
    High-Speed USB Host, Type-A receptacle type=USB n=1
    RJ-45 receptacle 10/100 Ethernet type=ETH n=1 m=100000000
    3-axis Digital Accelerometer in ICM-42670-P type=Accelerometer n=1
    3-axis Digital Gyroscope in ICM-42670-P type=Gyro n=1
    3-axis Digital Accelerometer in BMI323 type=Accelerometer n=1
    3-axis Digital Gyroscope in BMI323 type=Gyro n=1
    16-bit Digital Temperature Sensor in BMI323 type=TempSens n=1
    2x I2S Digital MICs and 2x PDM Digital MICs type=SensOther n=4
    5-position Joystick type=Joystick n=1
    Reset push-button type=Button n=1
    Multicolor LEDs type=LED n=2
    2-Lane MIPI CSI Connector for OnSemi ARX3A0 0.3MP 1/10.3 MONO type=Camera n=1
    4.3-inch Color TFT LCD with Capacitive Touchscreen type=GLCD n=1 m=480.800
    WE310F5 WiFi and Bluetooth LE module type=Other n=1
cpus:
  A32 core=Cortex-A32 revision=r1p0 endian=Configurable mpuPresent=false fpuPresent=true fpuDP=false dspPresent=true vtorPresent=false nvicPrioBits=0 vendorSystickConfig=false sauNumRegions=1 pmuPresent=true pmuNumEventCnt=6 mvePresent=false mveFP=false tzPresent=true cpuClock=800000000
  M55-HP core=Cortex-M55 revision=r1p0 endian=Configurable mpuPresent=true fpuPresent=true fpuDP=true dspPresent=true vtorPresent=true nvicPrioBits=8 vendorSystickConfig=false sauNumRegions=1 pmuPresent=true pmuNumEventCnt=8 mvePresent=true mveFP=true tzPresent=true cpuClock=400000000
  M55-HE core=Cortex-M55 revision=r1p0 endian=Configurable mpuPresent=true fpuPresent=true fpuDP=true dspPresent=true vtorPresent=true nvicPrioBits=8 vendorSystickConfig=false sauNumRegions=1 pmuPresent=true pmuNumEventCnt=8 mvePresent=true mveFP=true tzPresent=true cpuClock=160000000
memories:
  Backup_SRAM start=0x4902C000 size=0x00001000 access=rw default=1
  SRAM0 start=0x02000000 size=0x00400000 access=rw default=1
  SRAM1 start=0x08000000 size=0x00280000 access=rw default=1
  SRAM6_A start=0x62000000 size=0x00100000 access=rw default=1
  SRAM6_B start=0x62400000 size=0x00100000 access=rw default=1
  SRAM7 start=0x63000000 size=0x00080000 access=rw default=1
  SRAM8 start=0x63200000 size=0x00200000 access=rw default=1
  SRAM9_A start=0x60000000 size=0x00040000 access=rw default=1
  SRAM9_B start=0x60040000 size=0x00080000 access=rw default=1
  SRAM2 start=0x50000000 size=0x00040000 access=rw default=1
  SRAM3 start=0x50800000 size=0x00100000 access=rw default=1
  SRAM4 start=0x58000000 size=0x00040000 access=rw default=1
  SRAM5 start=0x58800000 size=0x00040000 access=rw default=1
  MRAM start=0x80000000 size=0x00580000 access=rx default=1
  OSPI0 start=0xA0000000 size=0x20000000 access=rwx default=1
  OSPI1 start=0xC0000000 size=0x20000000 access=rwx default=1
firewalls:
  FCTLR ProtectionExtension=PE.1 MonitorExtension=ME.0 TranslationExtension=TE.0 RegionSizeExtension=RSE.1 num_rgn=3 mnrs=4KB mxrs=2MB num_mpe=1 single_mst=0 location=Slave side protectedRegion=0x1A80_0000 - 0x1A8E_FFFF
  FC1 ProtectionExtension=PE.1 MonitorExtension=ME.0 TranslationExtension=TE.0 RegionSizeExtension=RSE.0 num_rgn=22 mnrs=4KB mxrs=512MB num_mpe=1 single_mst=0 location=Slave side protectedRegion=0x1000_0000 - 0x17FF_FFFF, 0x1B00_0000 - 0x1E0F_FFFF
  FC2 ProtectionExtension=PE.1 MonitorExtension=ME.0 TranslationExtension=TE.0 RegionSizeExtension=RSE.0 num_rgn=1 mnrs=4KB mxrs=512MB num_mpe=1 single_mst=0 location=Slave side protectedRegion=0x1800_0000 - 0x19FF_FFFF
  FC3 ProtectionExtension=PE.1 MonitorExtension=ME.0 TranslationExtension=TE.0 RegionSizeExtension=RSE.0 num_rgn=40 mnrs=4KB mxrs=8MB num_mpe=1 single_mst=0 location=Slave side protectedRegion=0x1A00_0000 - 0x1A60_FFFF
  FC4 ProtectionExtension=PE.2 MonitorExtension=ME.0 TranslationExtension=TE.0 RegionSizeExtension=RSE.1 num_rgn=32 mnrs=4KB mxrs=128MB num_mpe=4 single_mst=0 location=Slave side protectedRegion=0x0800_0000 - 0x0FFF_FFFF
  FC5 ProtectionExtension=PE.2 MonitorExtension=ME.0 TranslationExtension=TE.0 RegionSizeExtension=RSE.1 num_rgn=32 mnrs=256B mxrs=32MB num_mpe=4 single_mst=0 location=Slave side protectedRegion=0x0200_0000 - 0x03FF_FFFF
  FC6 ProtectionExtension=PE.0 MonitorExtension=ME.2 TranslationExtension=TE.0 RegionSizeExtension=RSE.0 num_rgn=NA mnrs=NA mxrs=NA num_mpe=NA single_mst=1 location=Master side protectedRegion=A32 address map (0x0000_0000 - 0xDFFF_FFFF)
  FC7 ProtectionExtension=PE.2 MonitorExtension=ME.2 TranslationExtension=TE.2 RegionSizeExtension=RSE.1 num_rgn=16 mnrs=4KB mxrs=4GB num_mpe=1 single_mst=1 location=Master side protectedRegion=M55-HP address map (0x0000_0000 - 0xFFFF_FFFF)
  FC8 ProtectionExtension=PE.2 MonitorExtension=ME.2 TranslationExtension=TE.2 RegionSizeExtension=RSE.1 num_rgn=16 mnrs=4KB mxrs=4GB num_mpe=1 single_mst=1 location=Master side protectedRegion=M55-HE address map (0x0000_0000 - 0xFFFF_FFFF)
  FC9 ProtectionExtension=PE.2 MonitorExtension=ME.2 TranslationExtension=TE.2 RegionSizeExtension=RSE.1 num_rgn=32 mnrs=4KB mxrs=4GB num_mpe=4 single_mst=0 location=Master side protectedRegion=Reserved
  FC10 ProtectionExtension=PE.2 MonitorExtension=ME.2 TranslationExtension=TE.2 RegionSizeExtension=RSE.1 num_rgn=8 mnrs=4KB mxrs=4GB num_mpe=4 single_mst=0 location=Master side protectedRegion=Reserved
  FC11 ProtectionExtension=PE.2 MonitorExtension=ME.0 TranslationExtension=TE.0 RegionSizeExtension=RSE.1 num_rgn=32 mnrs=256B mxrs=512MB num_mpe=4 single_mst=0 location=Slave side protectedRegion=0x4000_0000 - 0x5FFF_FFFF
  FC12 ProtectionExtension=PE.2 MonitorExtension=ME.0 TranslationExtension=TE.0 RegionSizeExtension=RSE.1 num_rgn=32 mnrs=256B mxrs=512MB num_mpe=4 single_mst=0 location=Slave side protectedRegion=0x6000_0000 - 0x6FFF_FFFF
  FC13 ProtectionExtension=PE.2 MonitorExtension=ME.0 TranslationExtension=TE.0 RegionSizeExtension=RSE.1 num_rgn=32 mnrs=4KB mxrs=2GB num_mpe=4 single_mst=0 location=Slave side protectedRegion=0x8000_0000 - 0xDFFF_FFFF
  FC14 ProtectionExtension=PE.2 MonitorExtension=ME.2 TranslationExtension=TE.2 RegionSizeExtension=RSE.1 num_rgn=8 mnrs=4KB mxrs=4GB num_mpe=2 single_mst=0 location=Master side protectedRegion=Reserved
pins:
  P0_0 location=L7 register=P0_0 offset=0x0 muxModes=GPIO0_0, OSPI0_D0_A, UART0_RX_A, I3C_SDA_A, UT0_T0_A, LPCAM_HSYNC_B, CAM_HSYNC_A, ANA_S0
  P0_1 location=H12 register=P0_1 offset=0x4 muxModes=GPIO0_1, OSPI0_D1_A, UART0_TX_A, I3C_SCL_A, UT0_T1_A, LPCAM_VSYNC_B, CAM_VSYNC_A, ANA_S1
  P0_2 location=J9 register=P0_2 offset=0x8 muxModes=GPIO0_2, OSPI0_D2_A, UART0_CTS_A, I2C0_SDA_A, UT1_T0_A, LPCAM_PCLK_B, CAM_PCLK_A, ANA_S2
  P0_3 location=N3 register=P0_3 offset=0xC muxModes=GPIO0_3, OSPI0_D3_A, UART0_RTS_A, I2C0_SCL_A, UT1_T1_A, LPCAM_XVCLK_B, CAM_XVCLK_A, ANA_S3
  P0_4 location=K8 register=P0_4 offset=0x10 muxModes=GPIO0_4, OSPI0_D4_A, UART1_RX_A, PDM_D0_A, I2C1_SDA_A, UT2_T0_A, CAN_RXD_B, ANA_S4
  P0_5 location=K6 register=P0_5 offset=0x14 muxModes=GPIO0_5, OSPI0_D5_A, UART1_TX_A, PDM_C0_A, I2C1_SCL_A, UT2_T1_A, CAN_TXD_B, ANA_S5
  P0_6 location=H10 register=P0_6 offset=0x18 muxModes=GPIO0_6, OSPI0_D6_A, UART1_CTS_A, PDM_D1_A, I2C2_SCL_A, UT3_T0_A, CAN_STBY_B, ANA_S6
  P0_7 location=J7 register=P0_7 offset=0x1C muxModes=GPIO0_7, OSPI0_D7_A, UART1_RTS_A, PDM_C1_A, I2C2_SDA_A, UT3_T1_A, CDC_DE_B, ANA_S7
  P1_0 location=L1 register=P1_0 offset=0x20 muxModes=GPIO1_0, UART2_RX_A, SPI0_MISO_A, I2C3_SDA_A, UT4_T0_A, LPCAM_HSYNC_C, ETH_RXD0_C, ANA_S8
  P1_1 location=L3 register=P1_1 offset=0x24 muxModes=GPIO1_1, UART2_TX_A, SPI0_MOSI_A, I2C3_SCL_A, UT4_T1_A, LPCAM_VSYNC_C, ETH_RXD1_C, ANA_S9
  P1_2 location=H8 register=P1_2 offset=0x28 muxModes=GPIO1_2, UART3_RX_A, SPI0_SCLK_A, I3C_SDA_B, UT5_T0_A, LPCAM_PCLK_C, ETH_RST_C, ANA_S10
  P1_3 location=K4 register=P1_3 offset=0x2C muxModes=GPIO1_3, UART3_TX_A, SPI0_SS0_A, I3C_SCL_B, UT5_T1_A, LPCAM_XVCLK_C, ETH_TXD0_C, ANA_S11
  P1_4 location=J5 register=P1_4 offset=0x30 muxModes=GPIO1_4, OSPI0_SS0_A, UART0_RX_B, SPI0_SS1_A, UT6_T0_A, LPCAM_D0_C, ETH_TXD1_C, ANA_S12
  P1_5 location=K2 register=P1_5 offset=0x34 muxModes=GPIO1_5, OSPI0_SS1_A, UART0_TX_B, SPI0_SS2_A, UT6_T1_A, LPCAM_D1_C, ETH_TXEN_C, ANA_S13
  P1_6 location=G9 register=P1_6 offset=0x38 muxModes=GPIO1_6, OSPI0_RXDS_B, UART1_RX_B, I2S0_SDI_A, UT7_T0_A, LPCAM_D2_C, ETH_IRQ_C, ANA_S14
  P1_7 location=H6 register=P1_7 offset=0x3C muxModes=GPIO1_7, OSPI0_SCLK_A, UART1_TX_B, I2S0_SDO_A, UT7_T1_A, LPCAM_D3_C, ETH_REFCLK_C, ANA_S15
  P2_0 location=G7 register=P2_0 offset=0x40 muxModes=GPIO2_0, OSPI0_D0_B, UART2_RX_B, LPPDM_D0_A, UT8_T0_A, LPCAM_D4_C, ETH_MDIO_C, ANA_S16
  P2_1 location=J3 register=P2_1 offset=0x44 muxModes=GPIO2_1, OSPI0_D1_B, UART2_TX_B, LPPDM_C0_A, UT8_T1_A, LPCAM_D5_C, ETH_MDC_C, ANA_S17
  P2_2 location=J1 register=P2_2 offset=0x48 muxModes=GPIO2_2, OSPI0_D2_B, UART3_RX_B, LPPDM_D1_A, UT9_T0_A, LPCAM_D6_C, ETH_CRS_DV_C, ANA_S18
  P2_3 location=H4 register=P2_3 offset=0x4C muxModes=GPIO2_3, OSPI0_D3_B, UART3_TX_B, LPPDM_C1_A, UT9_T1_A, LPCAM_D7_C, CDC_PCLK_B, ANA_S19
  P2_4 location=G5 register=P2_4 offset=0x50 muxModes=GPIO2_4, OSPI0_D4_B, LPI2S_SDI_A, SPI1_MISO_A, UT10_T0_A, LPCAM_D0_B, CAM_D0_A, ANA_S20
  P2_5 location=F12 register=P2_5 offset=0x54 muxModes=GPIO2_5, OSPI0_D5_B, LPI2S_SDO_A, SPI1_MOSI_A, UT10_T1_A, LPCAM_D1_B, CAM_D1_A, ANA_S21
  P2_6 location=H2 register=P2_6 offset=0x58 muxModes=GPIO2_6, OSPI0_D6_B, LPI2S_SCLK_A, SPI1_SCLK_A, UT11_T0_A, LPCAM_D2_B, CAM_D2_A, ANA_S22
  P2_7 location=F10 register=P2_7 offset=0x5C muxModes=GPIO2_7, OSPI0_D7_B, LPI2S_WS_A, SPI1_SS0_A, UT11_T1_A, LPCAM_D3_B, CAM_D3_A, ANA_S23
  P3_0 location=G17 register=P3_0 offset=0x60 muxModes=GPIO3_0, OSPI0_SCLK_B, UART4_RX_A, PDM_D0_B, I2S0_SCLK_A, QEC0_X_A, LPCAM_D4_B, CAM_D4_A
  P3_1 location=G19 register=P3_1 offset=0x64 muxModes=GPIO3_1, OSPI0_SCLKN_B, UART4_TX_A, PDM_C0_B, I2S0_WS_A, QEC0_Y_A, LPCAM_D5_B, CAM_D5_A
  P3_2 location=F22 register=P3_2 offset=0x68 muxModes=GPIO3_2, OSPI0_SS0_B, PDM_D1_B, I2S1_SDI_A, I3C_SDA_C, QEC0_Z_A, LPCAM_D6_B, CAM_D6_A
  P3_3 location=F20 register=P3_3 offset=0x6C muxModes=GPIO3_3, OSPI0_SS1_B, PDM_C1_B, I2S1_SDO_A, I3C_SCL_C, QEC1_X_A, LPCAM_D7_B, CAM_D7_A
  P3_4 location=G21 register=P3_4 offset=0x70 muxModes=GPIO3_4, OSPI0_RXDS_A, UART5_RX_A, LPPDM_C0_B, I2S1_SCLK_A, I2C0_SCL_B, QEC1_Y_A, CAM_D8_A
  P3_5 location=G23 register=P3_5 offset=0x74 muxModes=GPIO3_5, OSPI0_SCLKN_A, UART5_TX_A, LPPDM_D0_B, SPI0_SS1_B, I2C0_SDA_B, QEC1_Z_A, CAM_D9_A
  P3_6 location=P22 register=P3_6 offset=0x78 muxModes=GPIO3_6, HFXO_OUT_A, LPUART_CTS_B, LPPDM_C1_B, SPI0_SS2_B, I2C1_SDA_B, QEC2_X_A, CAM_D10_A
  P3_7 location=R23 register=P3_7 offset=0x7C muxModes=GPIO3_7, JTAG_TRACECLK, LPUART_RTS_B, LPPDM_D1_B, SPI1_SS1_A, I2C1_SCL_B, QEC2_Y_A, CAM_D11_A
  P4_0 location=E5 register=P4_0 offset=0x80 muxModes=GPIO4_0, JTAG_TDATA0, Reserved, I2S1_WS_A, SPI1_SS2_A, QEC2_Z_A, CDC_VSYNC_B, CAM_D12_A
  P4_1 location=A1 register=P4_1 offset=0x84 muxModes=GPIO4_1, JTAG_TDATA1, I2S0_SDI_B, SPI1_SS3_A, QEC3_X_A, SD_CLK_D, CDC_HSYNC_B, CAM_D13_A
  P4_2 location=E9 register=P4_2 offset=0x88 muxModes=GPIO4_2, JTAG_TDATA2, Reserved, I2S0_SDO_B, SPI2_MISO_A, QEC3_Y_A, SD_CMD_D, CAM_D14_A
  P4_3 location=D8 register=P4_3 offset=0x8C muxModes=GPIO4_3, JTAG_TDATA3, Reserved, I2S0_SCLK_B, SPI2_MOSI_A, QEC3_Z_A, SD_RST_D, CAM_D15_A
  P4_4 location=B4 register=P4_4 offset=0x90 muxModes=GPIO4_4, JTAG_TCK, I2S0_WS_B, SPI2_SCLK_A, FAULT0_A
  P4_5 location=A3 register=P4_5 offset=0x94 muxModes=GPIO4_5, JTAG_TMS, SPI2_SS0_A, FAULT1_A
  P4_6 location=C7 register=P4_6 offset=0x98 muxModes=GPIO4_6, JTAG_TDI, SPI2_SS1_A, FAULT2_A
  P4_7 location=E11 register=P4_7 offset=0x9C muxModes=GPIO4_7, JTAG_TDO, SPI2_SS2_A, FAULT3_A
  P5_0 location=B6 register=P5_0 offset=0xA0 muxModes=GPIO5_0, OSPI1_RXDS_A, UART4_RX_C, PDM_D2_A, SPI0_MISO_B, I2C2_SDA_B, UT0_T0_B, SD_D0_A
  P5_1 location=E13 register=P5_1 offset=0xA4 muxModes=GPIO5_1, OSPI1_SS0_A, UART4_TX_C, PDM_D3_A, SPI0_MOSI_B, I2C2_SCL_B, UT0_T1_B, SD_D1_A
  P5_2 location=B8 register=P5_2 offset=0xA8 muxModes=GPIO5_2, OSPI1_SCLKN_A, UART5_RX_C, PDM_C3_A, SPI0_SS0_B, LPI2C_SCL_B, UT1_T0_B, SD_D2_A
  P5_3 location=A7 register=P5_3 offset=0xAC muxModes=GPIO5_3, OSPI1_SCLK_A, UART5_TX_C, SPI0_SCLK_B, LPI2C_SDA_B, UT1_T1_B, SD_D3_A, CDC_PCLK_A
  P5_4 location=D12 register=P5_4 offset=0xB0 muxModes=GPIO5_4, OSPI1_SS1_A, UART3_CTS_A, PDM_D2_B, SPI0_SS3_A, UT2_T0_B, SD_D4_A, CDC_DE_A
  P5_5 location=C11 register=P5_5 offset=0xB4 muxModes=GPIO5_5, OSPI1_SCLK_C, UART3_RTS_A, PDM_D3_B, UT2_T1_B, SD_D5_A, ETH_RXD0_A, CDC_HSYNC_A
  P5_6 location=B10 register=P5_6 offset=0xB8 muxModes=GPIO5_6, Reserved, UART1_CTS_B, I2C2_SCL_C, UT3_T0_B, SD_D6_A, ETH_RXD1_A, CDC_VSYNC_A
  P5_7 location=A9 register=P5_7 offset=0xBC muxModes=GPIO5_7, OSPI1_SS0_C, UART1_RTS_B, I2C2_SDA_C, UT3_T1_B, SD_D7_A, ETH_RST_A
  P6_0 location=F14 register=P6_0 offset=0xC0 muxModes=GPIO6_0, OSPI0_D0_C, UART4_DE_A, PDM_D0_C, UT4_T0_B, SD_D0_D, ETH_TXD0_A
  P6_1 location=E15 register=P6_1 offset=0xC4 muxModes=GPIO6_1, OSPI0_D1_C, UART5_DE_A, PDM_C0_C, UT4_T1_B, SD_D1_D, ETH_TXD1_A
  P6_2 location=D14 register=P6_2 offset=0xC8 muxModes=GPIO6_2, OSPI0_D2_C, UART2_CTS_A, Reserved, PDM_D1_C, UT5_T0_B, SD_D2_D, ETH_TXEN_A
  P6_3 location=A11 register=P6_3 offset=0xCC muxModes=GPIO6_3, OSPI0_D3_C, UART2_RTS_A, Reserved, PDM_C1_C, UT5_T1_B, SD_D3_D, ETH_IRQ_A
  P6_4 location=B14 register=P6_4 offset=0xD0 muxModes=GPIO6_4, OSPI0_D4_C, UART2_CTS_B, Reserved, SPI1_SS0_B, UT6_T0_B, SD_D4_D, ETH_REFCLK_A
  P6_5 location=G15 register=P6_5 offset=0xD4 muxModes=GPIO6_5, OSPI0_D5_C, UART2_RTS_B, Reserved, SPI1_SS1_B, UT6_T1_B, SD_D5_D, ETH_MDIO_A
  P6_6 location=D16 register=P6_6 offset=0xD8 muxModes=GPIO6_6, OSPI0_D6_C, UART0_CTS_B, Reserved, SPI1_SS2_B, UT7_T0_B, SD_D6_D, ETH_MDC_A
  P6_7 location=C17 register=P6_7 offset=0xDC muxModes=GPIO6_7, OSPI0_D7_C, UART0_RTS_B, PDM_C2_A, SPI1_SS3_B, UT7_T1_B, SD_D7_D, ETH_CRS_DV_A
  P7_0 location=B18 register=P7_0 offset=0xE0 muxModes=GPIO7_0, Reserved, CMP3_OUT_A, SPI0_MISO_C, I2C0_SDA_C, UT8_T0_B, SD_CMD_A, CAN_RXD_A
  P7_1 location=D18 register=P7_1 offset=0xE4 muxModes=GPIO7_1, Reserved, CMP2_OUT_A, SPI0_MOSI_C, I2C0_SCL_C, UT8_T1_B, SD_CLK_A, CAN_TXD_A
  P7_2 location=F18 register=P7_2 offset=0xE8 muxModes=GPIO7_2, Reserved, UART3_CTS_B, CMP1_OUT_A, SPI0_SCLK_C, I2C1_SDA_C, UT9_T0_B, SD_RST_A
  P7_3 location=A19 register=P7_3 offset=0xEC muxModes=GPIO7_3, Reserved, UART3_RTS_B, CMP0_OUT_A, SPI0_SS0_C, I2C1_SCL_C, UT9_T1_B, CAN_STBY_A
  P7_4 location=M22 register=P7_4 offset=0xF0 muxModes=GPIO7_4, Reserved, LPUART_CTS_A, LPPDM_C2_A, LPSPI_MISO_A, LPI2C_SCL_A, UT10_T0_B
  P7_5 location=L19 register=P7_5 offset=0xF4 muxModes=GPIO7_5, Reserved, LPUART_RTS_A, Reserved, LPPDM_D2_A, LPSPI_MOSI_A, LPI2C_SDA_A, UT10_T1_B
  P7_6 location=N27 register=P7_6 offset=0xF8 muxModes=GPIO7_6, Reserved, LPUART_RX_A, Reserved, LPPDM_C3_A, LPSPI_SCLK_A, I3C_SDA_D, UT11_T0_B
  P7_7 location=N25 register=P7_7 offset=0xFC muxModes=GPIO7_7, Reserved, LPUART_TX_A, Reserved, LPPDM_D3_A, LPSPI_SS_A, I3C_SCL_D, UT11_T1_B
  P8_0 location=C19 register=P8_0 offset=0x100 muxModes=GPIO8_0, OSPI1_SCLKN_C, AUDIO_CLK_A, FAULT0_B, LPCAM_D0_A, SD_D0_C, CDC_D0_A, CAM_D0_B
  P8_1 location=E19 register=P8_1 offset=0x104 muxModes=GPIO8_1, I2S2_SDI_A, FAULT1_B, LPCAM_D1_A, SD_D1_C, CDC_D1_A, CAM_D1_B
  P8_2 location=B20 register=P8_2 offset=0x108 muxModes=GPIO8_2, I2S2_SDO_A, SPI0_SS3_B, FAULT2_B, LPCAM_D2_A, SD_D2_C, CDC_D2_A, CAM_D2_B
  P8_3 location=A21 register=P8_3 offset=0x10C muxModes=GPIO8_3, I2S2_SCLK_A, SPI1_MISO_B, FAULT3_B, LPCAM_D3_A, SD_D3_C, CDC_D3_A, CAM_D3_B
  P8_4 location=D20 register=P8_4 offset=0x110 muxModes=GPIO8_4, I2S2_WS_A, SPI1_MOSI_B, QEC0_X_B, LPCAM_D4_A, SD_D4_C, CDC_D4_A, CAM_D4_B
  P8_5 location=H28 register=P8_5 offset=0x114 muxModes=GPIO8_5, Reserved, SPI1_SCLK_B, QEC0_Y_B, LPCAM_D5_A, SD_D5_C, CDC_D5_A, CAM_D5_B
  P8_6 location=H22 register=P8_6 offset=0x118 muxModes=GPIO8_6, Reserved, I2S3_SCLK_B, QEC0_Z_B, LPCAM_D6_A, SD_D6_C, CDC_D6_A, CAM_D6_B
  P8_7 location=H20 register=P8_7 offset=0x11C muxModes=GPIO8_7, Reserved, I2S3_WS_B, QEC1_X_B, LPCAM_D7_A, SD_D7_C, CDC_D7_A, CAM_D7_B
  P9_0 location=H18 register=P9_0 offset=0x120 muxModes=GPIO9_0, Reserved, I2S3_SDI_B, QEC1_Y_B, SD_CMD_C, CDC_D8_A, CAM_D8_B
  P9_1 location=H16 register=P9_1 offset=0x124 muxModes=GPIO9_1, LPUART_RX_B, I2S3_SDO_B, QEC1_Z_B, SD_CLK_C, CDC_D9_A, CAM_D9_B
  P9_2 location=J27 register=P9_2 offset=0x128 muxModes=GPIO9_2, LPUART_TX_B, I2S3_SDI_A, SPI2_MISO_B, QEC2_X_B, SD_RST_C, CDC_D10_A, CAM_D10_B
  P9_3 location=J25 register=P9_3 offset=0x12C muxModes=GPIO9_3, HFXO_OUT_B, UART7_RX_B, I2S3_SDO_A, SPI2_MOSI_B, QEC2_Y_B, CDC_D11_A, CAM_D11_B
  P9_4 location=J23 register=P9_4 offset=0x130 muxModes=GPIO9_4, UART7_TX_B, I2S3_SCLK_A, SPI2_SCLK_B, I2C3_SDA_C, QEC2_Z_B, CDC_D12_A, CAM_D12_B
  P9_5 location=J21 register=P9_5 offset=0x134 muxModes=GPIO9_5, OSPI1_D0_C, I2S3_WS_A, SPI2_SS0_B, I2C3_SCL_C, QEC3_X_B, CDC_D13_A, CAM_D13_B
  P9_6 location=K28 register=P9_6 offset=0x138 muxModes=GPIO9_6, OSPI1_D1_C, AUDIO_CLK_B, SPI2_SS1_B, I2C3_SDA_B, QEC3_Y_B, CDC_D14_A, CAM_D14_B
  P9_7 location=J19 register=P9_7 offset=0x13C muxModes=GPIO9_7, OSPI1_D2_C, UART7_DE_B, SPI2_SS2_B, I2C3_SCL_B, QEC3_Z_B, CDC_D15_A, CAM_D15_B
  P10_0 location=K26 register=P10_0 offset=0x140 muxModes=GPIO10_0, OSPI1_D3_C, UART6_DE_B, SPI2_SS3_B, UT0_T0_C, LPCAM_HSYNC_A, CDC_D16_A, CAM_HSYNC_B
  P10_1 location=K24 register=P10_1 offset=0x144 muxModes=GPIO10_1, OSPI1_D4_C, Reserved, LPI2S_SDI_B, UT0_T1_C, LPCAM_VSYNC_A, CDC_D17_A, CAM_VSYNC_B
  P10_2 location=K22 register=P10_2 offset=0x148 muxModes=GPIO10_2, OSPI1_D5_C, Reserved, LPI2S_SDO_B, UT1_T0_C, LPCAM_PCLK_A, CDC_D18_A, CAM_PCLK_B
  P10_3 location=K20 register=P10_3 offset=0x14C muxModes=GPIO10_3, OSPI1_D6_C, Reserved, LPI2S_SCLK_B, UT1_T1_C, LPCAM_XVCLK_A, CDC_D19_A, CAM_XVCLK_B
  P10_4 location=L27 register=P10_4 offset=0x150 muxModes=GPIO10_4, OSPI1_D7_C, Reserved, LPI2S_WS_B, I2C0_SDA_D, UT2_T0_C, ETH_TXD0_B, CDC_D20_A
  P10_5 location=L25 register=P10_5 offset=0x154 muxModes=GPIO10_5, UART6_RX_A, I2S2_SDI_B, SPI3_MISO_B, I2C0_SCL_D, UT2_T1_C, ETH_TXD1_B, CDC_D21_A
  P10_6 location=L23 register=P10_6 offset=0x158 muxModes=GPIO10_6, UART6_TX_A, I2S2_SDO_B, SPI3_MOSI_B, I2C1_SDA_D, UT3_T0_C, ETH_TXEN_B, CDC_D22_A
  P10_7 location=L21 register=P10_7 offset=0x15C muxModes=GPIO10_7, UART7_RX_A, I2S2_SCLK_B, SPI3_SCLK_B, I2C1_SCL_D, UT3_T1_C, CDC_D23_A, OSPI1_RXDS_C
  P11_0 location=M28 register=P11_0 offset=0x160 muxModes=GPIO11_0, OSPI1_D0_A, UART7_TX_A, I2S2_WS_B, SPI3_SS0_B, UT4_T0_C, ETH_REFCLK_B, CDC_D0_B
  P11_1 location=J17 register=P11_1 offset=0x164 muxModes=GPIO11_1, OSPI1_D1_A, UART7_DE_A, SPI3_SS1_B, UT4_T1_C, ETH_MDIO_B, CDC_D1_B
  P11_2 location=M26 register=P11_2 offset=0x168 muxModes=GPIO11_2, OSPI1_D2_A, UART6_DE_A, LPPDM_C2_B, SPI3_SS2_B, UT5_T0_C, ETH_MDC_B, CDC_D2_B
  P11_3 location=M24 register=P11_3 offset=0x16C muxModes=GPIO11_3, OSPI1_D3_A, UART5_RX_B, LPPDM_C3_B, SPI3_SS3_B, UT5_T1_C, ETH_RXD0_B, CDC_D3_B
  P11_4 location=N19 register=P11_4 offset=0x170 muxModes=GPIO11_4, OSPI1_D4_A, UART5_TX_B, PDM_C2_B, LPSPI_MISO_B, UT6_T0_C, ETH_RXD1_B, CDC_D4_B
  P11_5 location=P20 register=P11_5 offset=0x174 muxModes=GPIO11_5, OSPI1_D5_A, UART6_RX_B, PDM_C3_B, LPSPI_MOSI_B, UT6_T1_C, ETH_CRS_DV_B, CDC_D5_B
  P11_6 location=K16 register=P11_6 offset=0x178 muxModes=GPIO11_6, OSPI1_D6_A, UART6_TX_B, LPPDM_D2_B, LPSPI_SCLK_B, UT7_T0_C, ETH_RST_B, CDC_D6_B
  P11_7 location=R21 register=P11_7 offset=0x17C muxModes=GPIO11_7, OSPI1_D7_A, UART5_DE_B, LPPDM_D3_B, LPSPI_SS_B, UT7_T1_C, ETH_IRQ_B, CDC_D7_B
  P12_0 location=D2 register=P12_0 offset=0x180 muxModes=GPIO12_0, OSPI0_SCLK_C, AUDIO_CLK_C, I2S1_SDI_B, UT8_T0_C, CDC_D8_B
  P12_1 location=D4 register=P12_1 offset=0x184 muxModes=GPIO12_1, OSPI0_SCLKN_C, UART4_RX_B, I2S1_SDO_B, UT8_T1_C, CDC_D9_B
  P12_2 location=C1 register=P12_2 offset=0x188 muxModes=GPIO12_2, OSPI0_RXDS_C, UART4_TX_B, I2S1_SCLK_B, UT9_T0_C, CDC_D10_B
  P12_3 location=E7 register=P12_3 offset=0x18C muxModes=GPIO12_3, OSPI0_SS0_C, UART4_DE_B, I2S1_WS_B, UT9_T1_C, CDC_D11_B
  P12_4 location=A15 register=P12_4 offset=0x190 muxModes=GPIO12_4, OSPI0_SS1_C, SPI3_MISO_A, UT10_T0_C, CAN_RXD_C, CDC_D12_B
  P12_5 location=B16 register=P12_5 offset=0x194 muxModes=GPIO12_5, Reserved, SPI3_MOSI_A, UT10_T1_C, CAN_TXD_C, CDC_D13_B
  P12_6 location=F16 register=P12_6 offset=0x198 muxModes=GPIO12_6, Reserved, SPI3_SCLK_A, UT11_T0_C, CAN_STBY_C, CDC_D14_B
  P12_7 location=E17 register=P12_7 offset=0x19C muxModes=GPIO12_7, OSPI1_RXDS_B, Reserved, SPI3_SS0_A, UT11_T1_C, CDC_D15_B
  P13_0 location=F2 register=P13_0 offset=0x1A0 muxModes=GPIO13_0, OSPI1_D0_B, Reserved, SPI3_SS1_A, QEC0_X_C, SD_D0_B, CDC_D16_B
  P13_1 location=F6 register=P13_1 offset=0x1A4 muxModes=GPIO13_1, OSPI1_D1_B, SPI3_SS2_A, QEC0_Y_C, SD_D1_B, CDC_D17_B
  P13_2 location=F8 register=P13_2 offset=0x1A8 muxModes=GPIO13_2, OSPI1_D2_B, SPI3_SS3_A, QEC0_Z_C, SD_D2_B, CDC_D18_B
  P13_3 location=E1 register=P13_3 offset=0x1AC muxModes=GPIO13_3, OSPI1_D3_B, SPI2_SS3_A, QEC1_X_C, SD_D3_B, CDC_D19_B
  P13_4 location=E3 register=P13_4 offset=0x1B0 muxModes=GPIO13_4, OSPI1_D4_B, LPI2S_SDI_C, QEC1_Y_C, SD_D4_B, CDC_D20_B
  P13_5 location=A5 register=P13_5 offset=0x1B4 muxModes=GPIO13_5, OSPI1_D5_B, LPI2S_SDO_C, QEC1_Z_C, SD_D5_B, CDC_D21_B
  P13_6 location=D10 register=P13_6 offset=0x1B8 muxModes=GPIO13_6, OSPI1_D6_B, LPI2S_SCLK_C, QEC2_X_C, SD_D6_B, CDC_D22_B
  P13_7 location=C9 register=P13_7 offset=0x1BC muxModes=GPIO13_7, OSPI1_D7_B, LPI2S_WS_C, QEC2_Y_C, SD_D7_B, CDC_D23_B
  P14_0 location=A17 register=P14_0 offset=0x1C0 muxModes=GPIO14_0, OSPI1_SCLK_B, UART6_RX_C, QEC2_Z_C, SD_CMD_B
  P14_1 location=G27 register=P14_1 offset=0x1C4 muxModes=GPIO14_1, OSPI1_SCLKN_B, UART6_TX_C, Reserved, QEC3_X_C, SD_CLK_B
  P14_2 location=G25 register=P14_2 offset=0x1C8 muxModes=GPIO14_2, OSPI1_SS0_B, UART7_RX_C, Reserved, QEC3_Y_C, SD_RST_B
  P14_3 location=P18 register=P14_3 offset=0x1CC muxModes=GPIO14_3, OSPI1_SS1_B, UART7_TX_C, Reserved, QEC3_Z_C
  P14_4 location=R19 register=P14_4 offset=0x1D0 muxModes=GPIO14_4, CMP3_OUT_B, SPI1_MISO_C, FAULT0_C
  P14_5 location=M16 register=P14_5 offset=0x1D4 muxModes=GPIO14_5, CMP2_OUT_B, SPI1_MOSI_C, FAULT1_C
  P14_6 location=L15 register=P14_6 offset=0x1D8 muxModes=GPIO14_6, CMP1_OUT_B, SPI1_SCLK_C, FAULT2_C
  P14_7 location=R17 register=P14_7 offset=0x1DC muxModes=GPIO14_7, CMP0_OUT_B, SPI1_SS0_C, FAULT3_C
  P15_0 location=K18 register=LPGPIO_CTRL_0 offset=0x0 muxModes=GPIOV_0, LPTMR0_CLK_IO
  P15_1 location=N23 register=LPGPIO_CTRL_1 offset=0x4 muxModes=GPIOV_1, LPTMR1_CLK_IO
  P15_2 location=N21 register=LPGPIO_CTRL_2 offset=0x8 muxModes=GPIOV_2, LPTMR2_CLK_IO
  P15_3 location=P26 register=LPGPIO_CTRL_3 offset=0xC muxModes=GPIOV_3, LPTMR3_CLK_IO
  P15_4 location=R27 register=LPGPIO_CTRL_4 offset=0x10 muxModes=GPIOV_4
  P15_5 location=J15 register=LPGPIO_CTRL_5 offset=0x14 muxModes=GPIOV_5
  P15_6 location=L17 register=LPGPIO_CTRL_6 offset=0x18 muxModes=GPIOV_6
  P15_7 location=M18 register=LPGPIO_CTRL_7 offset=0x1C muxModes=GPIOV_7
  SEUART_RX location=B2 register=NA offset=NA muxModes=SEUART_RX
  SEUART_TX location=C5 register=NA offset=NA muxModes=SEUART_TX
  N.C. location=C3 register=NA offset=NA muxModes=N.C.
  N.C. location=G11 register=NA offset=NA muxModes=N.C.
  N.C. location=E23 register=NA offset=NA muxModes=N.C.
  N.C. location=E21 register=NA offset=NA muxModes=N.C.
  N.C. location=C27 register=NA offset=NA muxModes=N.C.
  N.C. location=C15 register=NA offset=NA muxModes=N.C.
  N.C. location=C23 register=NA offset=NA muxModes=N.C.
  N.C. location=C25 register=NA offset=NA muxModes=N.C.
  N.C. location=B26 register=NA offset=NA muxModes=N.C.
  N.C. location=B28 register=NA offset=NA muxModes=N.C.
  N.C. location=D26 register=NA offset=NA muxModes=N.C.
  N.C. location=D28 register=NA offset=NA muxModes=N.C.
  N.C. location=F24 register=NA offset=NA muxModes=N.C.
  N.C. location=F28 register=NA offset=NA muxModes=N.C.
  NSRST location=D6 register=NA offset=NA muxModes=NSRST
  POR_N location=K10 register=NA offset=NA muxModes=POR_N
  HFXO_P location=A23 register=NA offset=NA muxModes=HFXO_P
  HFXO_N location=A25 register=NA offset=NA muxModes=HFXO_N
  LFXO_P location=R5 register=NA offset=NA muxModes=LFXO_P
  LFXO_N location=P6 register=NA offset=NA muxModes=LFXO_N
  VREF_P location=M4 register=NA offset=NA muxModes=VREF_P
  VREF_N location=M2 register=NA offset=NA muxModes=VREF_N
  VDD_MAIN location=L5 register=NA offset=NA muxModes=VDD_MAIN
  VDD_BATT location=K12 register=NA offset=NA muxModes=VDD_BATT
  VDD_BUCK location=P2 register=NA offset=NA muxModes=VDD_BUCK
  VDD_IO_FLEX location=P28 register=NA offset=NA muxModes=VDD_IO_FLEX
  VDD_IO_1V8 location=C13 register=NA offset=NA muxModes=VDD_IO_1V8
  VDD_IO_1V8 location=F4 register=NA offset=NA muxModes=VDD_IO_1V8
  VDD_IO_1V8 location=P24 register=NA offset=NA muxModes=VDD_IO_1V8
  VDD_CORE_0V8 location=A13 register=NA offset=NA muxModes=VDD_CORE_0V8
  VDD_CORE_0V8 location=G3 register=NA offset=NA muxModes=VDD_CORE_0V8
  VDD_CORE_0V8 location=H24 register=NA offset=NA muxModes=VDD_CORE_0V8
  VDD_CORE_0V8 location=N17 register=NA offset=NA muxModes=VDD_CORE_0V8
  VREG_MIPI_0V8 location=L13 register=NA offset=NA muxModes=VREG_MIPI_0V8
  VDD_MIPI_1V8 location=M12 register=NA offset=NA muxModes=VDD_MIPI_1V8
  VDD_USB_3V3 location=P14 register=NA offset=NA muxModes=VDD_USB_3V3
  VDD_SX_0V8 location=C21 register=NA offset=NA muxModes=VDD_SX_0V8
  VSS location=B24 register=NA offset=NA muxModes=VSS
  VSS location=F26 register=NA offset=NA muxModes=VSS
  VSS location=B22 register=NA offset=NA muxModes=VSS
  VSS location=R13 register=NA offset=NA muxModes=VSS
  VSS location=B12 register=NA offset=NA muxModes=VSS
  VSS location=D22 register=NA offset=NA muxModes=VSS
  VSS location=R9 register=NA offset=NA muxModes=VSS
  VSS location=E25 register=NA offset=NA muxModes=VSS
  VSS location=E27 register=NA offset=NA muxModes=VSS
  VSS location=L9 register=NA offset=NA muxModes=VSS
  VSS location=G1 register=NA offset=NA muxModes=VSS
  VSS location=H26 register=NA offset=NA muxModes=VSS
  VSS location=M20 register=NA offset=NA muxModes=VSS
  VSS location=R25 register=NA offset=NA muxModes=VSS
  VSS_BUCK location=R3 register=NA offset=NA muxModes=VSS_BUCK
  VSS_ANA location=N1 register=NA offset=NA muxModes=VSS_ANA
  VREG_CORE_0V8 location=M6 register=NA offset=NA muxModes=VREG_CORE_0V8
  VREG_AON location=L11 register=NA offset=NA muxModes=VREG_AON
  VREG_LP_1V8 location=N5 register=NA offset=NA muxModes=VREG_LP_1V8
  VREG_DIG_1V8 location=J11 register=NA offset=NA muxModes=VREG_DIG_1V8
  VREG_MIPI_1V8 location=G13 register=NA offset=NA muxModes=VREG_MIPI_1V8
  VSW location=R1 register=NA offset=NA muxModes=VSW
  VSW location=P4 register=NA offset=NA muxModes=VSW
  USB_REXT location=K14 register=NA offset=NA muxModes=USB_REXT
  USB_DP location=R15 register=NA offset=NA muxModes=USB_DP
  USB_DM location=N15 register=NA offset=NA muxModes=USB_DM
  USB_VBUS location=H14 register=NA offset=NA muxModes=USB_VBUS
  USB_IO_ID location=P16 register=NA offset=NA muxModes=USB_IO_ID
  MIPI_REXT location=J13 register=NA offset=NA muxModes=MIPI_REXT
  MIPICSI_0_P location=P8 register=NA offset=NA muxModes=MIPICSI_0_P
  MIPICSI_0_N location=R7 register=NA offset=NA muxModes=MIPICSI_0_N
  MIPICSI_1_P location=M10 register=NA offset=NA muxModes=MIPICSI_1_P
  MIPICSI_1_N location=N9 register=NA offset=NA muxModes=MIPICSI_1_N
  MIPICSI_C_P location=M8 register=NA offset=NA muxModes=MIPICSI_C_P
  MIPICSI_C_N location=N7 register=NA offset=NA muxModes=MIPICSI_C_N
  MIPIDSI_0_P location=P10 register=NA offset=NA muxModes=MIPIDSI_0_P
  MIPIDSI_0_N location=N11 register=NA offset=NA muxModes=MIPIDSI_0_N
  MIPIDSI_1_P location=N13 register=NA offset=NA muxModes=MIPIDSI_1_P
  MIPIDSI_1_N location=M14 register=NA offset=NA muxModes=MIPIDSI_1_N
  MIPIDSI_C_P location=R11 register=NA offset=NA muxModes=MIPIDSI_C_P
  MIPIDSI_C_N location=P12 register=NA offset=NA muxModes=MIPIDSI_C_N
clocks:
  CRC0
    HCLK clkSource=SYST_HCLK clkDesc=CRC0 AHB slave interface clock
  CRC1
    HCLK clkSource=SYST_HCLK clkDesc=CRC1 AHB slave interface clock
  GIC
    CLKIN clkSource=SYST_REFCLK clkDesc=GIC functional and interface clock
  IRQRTR
    CLKIN clkSource=SYST_REFCLK clkDesc=IRQRTR functional and interface clock
  EVTRTR0
    CLKIN clkSource=SYST_ACLK clkDesc=EVTRTR0 functional and interface clock
  EVTRTR1
    CLKIN clkSource=RTSS_HP_CLK clkDesc=EVTRTR1 functional and interface clock
  EVTRTR2
    CLKIN clkSource=RTSS_HE_CLK clkDesc=EVTRTR2 functional and interface clock
  DMA0_SEC
    ACLK clkSource=SYST_ACLK clkDesc=AXI master interface clock and DMAC functional clock
  DMA0_NS
    ACLK clkSource=SYST_ACLK clkDesc=AXI master interface clock and DMAC functional clock
  DMA1_SEC
    ACLK clkSource=SYST_ACLK clkDesc=AXI master interface clock and DMAC functional clock
  DMA1_NS
    ACLK clkSource=SYST_ACLK clkDesc=AXI master interface clock and DMAC functional clock
  DMA2_SEC
    ACLK clkSource=SYST_ACLK clkDesc=AXI master interface clock and DMAC functional clock
  DMA2_NS
    ACLK clkSource=SYST_ACLK clkDesc=AXI master interface clock and DMAC functional clock
  LPTIMER0
    LPTIMER0_CLK clkSource=S32K_CLK, 128 kHz, or LPTMR0_CLK_IO pin (selection in TIMER_CLKSEL[SEL1] register bit) clkDesc=LPTIMER0 timer clock
    PCLK clkSource=SYST_PCLK clkDesc=LPTIMER0 APB bus clock
  LPTIMER1
    LPTIMER1_CLK clkSource=S32K_CLK, 128 kHz, LPTMR1_CLK_IO pin, or LPTMR0_OUT (selection in TIMER_CLKSEL[SEL2] register bit) clkDesc=LPTIMER1 timer clock
    PCLK clkSource=SYST_PCLK clkDesc=LPTIMER1 APB bus clock
  LPTIMER2
    LPTIMER2_CLK clkSource=S32K_CLK, 128 kHz, or LPTMR2_CLK_IO pin (selection in TIMER_CLKSEL[SEL3] register bit) clkDesc=LPTIMER2 timer clock
    PCLK clkSource=SYST_PCLK clkDesc=LPTIMER2 APB bus clock
  LPTIMER3
    LPTIMER3_CLK clkSource=S32K_CLK, 128 kHz, LPTMR3_CLK_IO pin, or LPTMR2_OUT (selection in TIMER_CLKSEL[SEL4] register bit) clkDesc=LPTIMER3 timer clock
    PCLK clkSource=SYST_PCLK clkDesc=LPTIMER3 APB bus clock
  UTIMER{n} (n=0..11)
    ACLK clkSource=SYST_ACLK clkDesc=Internal core clock
    HCLK clkSource=SYST_HCLK clkDesc=AHB interface clock
  QEC0
    ACLK clkSource=SYST_ACLK clkDesc=Internal core clock
    HCLK clkSource=SYST_HCLK clkDesc=AHB interface clock
  QEC1
    ACLK clkSource=SYST_ACLK clkDesc=Internal core clock
    HCLK clkSource=SYST_HCLK clkDesc=AHB interface clock
  QEC2
    ACLK clkSource=SYST_ACLK clkDesc=Internal core clock
    HCLK clkSource=SYST_HCLK clkDesc=AHB interface clock
  QEC3
    ACLK clkSource=SYST_ACLK clkDesc=Internal core clock
    HCLK clkSource=SYST_HCLK clkDesc=AHB interface clock
  WDT_AP
    WDOGCLK2 clkSource=SYST_REFCLK clkDesc=Input clock to WDT_AP
  WDT_AP_S
    WDOGCLK3 clkSource=SYST_REFCLK clkDesc=Input clock to WDT_AP_S
  WDT_HP
    PCLK clkSource=SYST_PCLK clkDesc=APB interface clock
    WDOGCLK0 clkSource=RTSS_HP_CLK clkDesc=WDT_HP functional clock
  WDT_HE
    PCLK clkSource=SYST_PCLK clkDesc=APB interface clock
    WDOGCLK1 clkSource=RTSS_HE_CLK clkDesc=WDT_HE functional clock
  LPRTC
    LPRTC_CLK clkSource=S32K_CLK; Clock source for S32K_CLK (LFRC or LFXO) can be selected by the clock select register bit: MISC_CTRL[SEL_32K] clkDesc=LPRTC counter clock
    PCLK clkSource=SYST_PCLK clkDesc=LPRTC APB bus clock
  GPIO{n} (n=0..14)
    DBCLK clkSource=S32K_CLK / DIV; Clock gating and clock speed for GPIO debounce clock can be controlled by the GPIO_CTRLn[DB_CKEN], [DB_CKDIV] fields clkDesc=GPIO{n} debounce clock
    PCLK clkSource=SYST_PCLK clkDesc=GPIO{n} APB interface clock
    PCLK_INTR clkSource=SYST_PCLK clkDesc=GPIO{n} interrupt clock
  LPGPIO
    PCLK clkSource=SYST_PCLK clkDesc=LPGPIO APB interface clock
    PCLK_INTR clkSource=SYST_PCLK clkDesc=LPGPIO interrupt clock
  CANFD
    CANFD_CLK clkSource=(HFOSC_CLK or 160M_CLK) / DIV (selection in CANFD_CTRL[CLK_SEL] register bit); (divider can be controlled by the CANFD_CTRL[CKDIV] field) clkDesc=CANFD functional clock
    CANFD_HOST_CLK clkSource=SYST_PCLK clkDesc=CANFD APB host interface clock
    CANFD_TIMER_CLK clkSource=SYST_PCLK clkDesc=CANFD CAN-CNT counter clock
  ETH
    ACLK clkSource=SYST_ACLK clkDesc=AXI master interface clock. The DMA also uses this clock.
    CLK_CSR clkSource=SYST_HCLK clkDesc=AHB slave interface clock
    CLK_PTP clkSource=100M_CLK clkDesc=Reference clock for the timestamp update logic
    RMII_CLK clkSource=ETH_CLK; Selection in ETH_CTRL0[RMII_CLKSEL] clkDesc=RMII Clock. This is the 50-MHz clock used by the RMII interface.
    RX_CLK clkSource=ETH_CLK/2 or ETH_CLK/2/10; Selection in ETH_MAC_CONFIGURATION[FES] clkDesc=Receive clock
    TX_CLK clkSource=ETH_CLK/2 or ETH_CLK/2/10; Selection in ETH_MAC_CONFIGURATION[FES] clkDesc=Transmit clock
  I2C0
    IC_CLK clkSource=SYST_PCLK clkDesc=I2C0 peripheral clock
    PCLK clkSource=SYST_PCLK clkDesc=I2C0 APB interface clock
  I2C1
    IC_CLK clkSource=SYST_PCLK clkDesc=I2C1 peripheral clock
    PCLK clkSource=SYST_PCLK clkDesc=I2C1 APB interface clock
  I2C2
    IC_CLK clkSource=SYST_PCLK clkDesc=I2C2 peripheral clock
    PCLK clkSource=SYST_PCLK clkDesc=I2C2 APB interface clock
  I2C3
    IC_CLK clkSource=SYST_PCLK clkDesc=I2C3 peripheral clock
    PCLK clkSource=SYST_PCLK clkDesc=I2C3 APB interface clock
  LPI2C
    PCLK clkSource=SYST_PCLK clkDesc=LPI2C APB interface and peripheral clock
  I2S0
    PCLK clkSource=SYST_PCLK clkDesc=APB slave interface clock
    SCLK clkSource=(76M8_CLK or AUDIO_CLK) / DIV (selection in I2Sn_CTRL[CLK_SEL] register bit); (Divider can be controlled by the I2Sn_CTRL[CKDIV] field) clkDesc=Serial interface clock
    SCLK_N clkSource=(76M8_CLK or AUDIO_CLK) / DIV (selection in I2Sn_CTRL[CLK_SEL] register bit); (Divider can be controlled by the I2Sn_CTRL[CKDIV] field) clkDesc=Inverted serial interface clock
  I2S1
    PCLK clkSource=SYST_PCLK clkDesc=APB slave interface clock
    SCLK clkSource=(76M8_CLK or AUDIO_CLK) / DIV (selection in I2Sn_CTRL[CLK_SEL] register bit); (Divider can be controlled by the I2Sn_CTRL[CKDIV] field) clkDesc=Serial interface clock
    SCLK_N clkSource=(76M8_CLK or AUDIO_CLK) / DIV (selection in I2Sn_CTRL[CLK_SEL] register bit); (Divider can be controlled by the I2Sn_CTRL[CKDIV] field) clkDesc=Inverted serial interface clock
  I2S2
    PCLK clkSource=SYST_PCLK clkDesc=APB slave interface clock
    SCLK clkSource=(76M8_CLK or AUDIO_CLK) / DIV (selection in I2Sn_CTRL[CLK_SEL] register bit); (Divider can be controlled by the I2Sn_CTRL[CKDIV] field) clkDesc=Serial interface clock
    SCLK_N clkSource=(76M8_CLK or AUDIO_CLK) / DIV (selection in I2Sn_CTRL[CLK_SEL] register bit); (Divider can be controlled by the I2Sn_CTRL[CKDIV] field) clkDesc=Inverted serial interface clock
  I2S3
    PCLK clkSource=SYST_PCLK clkDesc=APB slave interface clock
    SCLK clkSource=(76M8_CLK or AUDIO_CLK) / DIV (selection in I2Sn_CTRL[CLK_SEL] register bit); (Divider can be controlled by the I2Sn_CTRL[CKDIV] field) clkDesc=Serial interface clock
    SCLK_N clkSource=(76M8_CLK or AUDIO_CLK) / DIV (selection in I2Sn_CTRL[CLK_SEL] register bit); (Divider can be controlled by the I2Sn_CTRL[CKDIV] field) clkDesc=Inverted serial interface clock
  LPI2S
    PCLK clkSource=SYST_PCLK clkDesc=APB slave interface clock
    SCLK clkSource=(76M8_CLK or AUDIO_CLK) / DIV (selection in HE_I2S_CTRL[CLK_SEL] register bit); (Divider can be controlled by the HE_I2S_CTRL[CLK_DIVISOR] field) clkDesc=Serial interface clock
    SCLK_N clkSource=(76M8_CLK or AUDIO_CLK) / DIV (selection in HE_I2S_CTRL[CLK_SEL] register bit); (Divider can be controlled by the HE_I2S_CTRL[CLK_DIVISOR] field) clkDesc=Inverted serial interface clock
  I3C
    CORE_CLK clkSource=SYST_PCLK clkDesc=I3C core interface clock
    DMA_CLK clkSource=SYST_PCLK clkDesc=I3C SDMA interface clock
    PCLK clkSource=SYST_PCLK clkDesc=I3C APB interface clock
  PDM
    PCLK clkSource=SYST_PCLK clkDesc=PDM APB interface clock
    PDM_CLK clkSource=76M8_CLK or AUDIO_CLK; Clock selection in EXPMST0_CTRL[PDM_SEL] register bit clkDesc=PDM functional clock
  LPPDM
    LPPDM_CLK clkSource=76M8_CLK or AUDIO_CLK; Clock selection in HE_CLK_ENA[PDM_CKSEL] register bit clkDesc=LPPDM functional clock
    PCLK clkSource=SYST_PCLK clkDesc=LPPDM APB interface clock
  SPI0
    HCLK clkSource=SYST_HCLK clkDesc=SPI0 AHB interface clock
    SPI_0_CLK clkSource=SYST_HCLK clkDesc=SPI0 core clock is identical to AHB interface clock
  SPI1
    HCLK clkSource=SYST_HCLK clkDesc=SPI1 AHB interface clock
    SPI_1_CLK clkSource=SYST_HCLK clkDesc=SPI1 core clock is identical to AHB interface clock
  SPI2
    HCLK clkSource=SYST_HCLK clkDesc=SPI2 AHB interface clock
    SPI_2_CLK clkSource=SYST_HCLK clkDesc=SPI2 core clock is identical to AHB interface clock
  SPI3
    HCLK clkSource=SYST_HCLK clkDesc=SPI3 AHB interface clock
    SPI_3_CLK clkSource=SYST_HCLK clkDesc=SPI3 core clock is identical to AHB interface clock
  LPSPI
    LPSPI_CLK clkSource=RTSS_HE_CLK clkDesc=LPSPI core clock
    PCLK clkSource=RTSS_HE_CLK clkDesc=LPSPI APB interface clock
  UART{n} (n=0..7)
    PCLK clkSource=SYST_PCLK clkDesc=UART{n} APB interface clock
    SCLK clkSource=HFOSC_CLK or SYST_PCLK; (selection in UART_CTRL[CLK_SEL] register field) clkDesc=UART{n} serial interface clock
  LPUART
    PCLK clkSource=SYST_PCLK clkDesc=LPUART APB interface clock
    SCLK clkSource=RTSS_HE_CLK clkDesc=LPUART serial interface clock
  USB
    BUS_CLK clkSource=SYST_HCLK clkDesc=AHB interface clock
    REF_CLK clkSource=10M_CLK clkDesc=REF_CLK generates the ITP counter when the UTMI PHY is in the suspended state (10 MHz)
  USB2PHY
    USB2_REFCLOCK clkSource=USB_CLK clkDesc=PHY PLL reference clock (20 MHz)
  OSPI0
    HCLK clkSource=SYST_HCLK clkDesc=OSPI0 AHB interface clock
    OSPI0_CLK clkSource=SYST_ACLK clkDesc=OSPI0 internal core clock
  OSPI1
    HCLK clkSource=SYST_HCLK clkDesc=OSPI1 AHB interface clock
    OSPI1_CLK clkSource=SYST_ACLK clkDesc=OSPI1 internal core clock
  AES0
    HCLK clkSource=SYST_HCLK clkDesc=AES0 AHB interface clock
  AES1
    HCLK clkSource=SYST_HCLK clkDesc=AES1 AHB interface clock
  SDMMC
    ACLK clkSource=SYST_ACLK clkDesc=AXI master interface clock
    BCLK clkSource=100M_CLK clkDesc=SDMMC core base clock
    CCLK_RX clkSource=For more information, see Section SDMMC Clocking clkDesc=SDMMC card receive clock
    CCLK_TX clkSource=For more information, see Section SDMMC Clocking clkDesc=SDMMC card transmit clock
    HCLK clkSource=SYST_HCLK clkDesc=AHB slave interface clock
    TMCLK clkSource=10M_CLK clkDesc=SDMMC timer clock
  CPI
    ACLK clkSource=SYST_ACLK clkDesc=CPI AXI interface clock
    PCLK clkSource=SYST_PCLK clkDesc=CPI APB interface clock
    PIXEL_CLK clkSource=Source selection in CAM_CFG[MIPI_CSI] bit and depends on the pixel data interface in use. When external camera interface is used, the CAM_PCLK polarity is controlled via CAM_CFG[PCLK_POL] bit. When MIPI CSI interface is used, the CSI PIXLCK is determined by the CSI_PIXCLK_CTRL[CLK_SEL] and [CLK_DIVISOR] fields clkDesc=CPI pixel clock
  LPCPI
    ACLK clkSource=RTSS_HE_CLK clkDesc=LPCPI AXI interface clock
    PCLK clkSource=SYST_PCLK clkDesc=LPCPI APB interface clock
    PIXEL_CLK clkSource=The LPCAM_PCLK polarity is controlled via CAM_CFG[PCLK_POL] bit clkDesc=LPCPI pixel clock
  CSI
    PCLK clkSource=SYST_PCLK clkDesc=CSI APB slave interface clock
    PIXCLK clkSource=(SYST_ACLK or PLL_CLK3) / Div ; (source selection and divider value can be configured in the CSI_PIXCLK_CTRL[CLK_SEL][CLK_DIVISOR] register fields) clkDesc=CSI IPI interface pixel clock
    RXBYTECLKHS clkSource=D-PHY RX clkDesc=CSI high-speed receive byte clock
  D-PHYRX
    CFG_CLK clkSource=100M_CLK/4 clkDesc=CSI D-PHY RX configuration clock (25 MHz)
  A32Cluster
    CLKIN clkSource=APSS_CLK clkDesc=A32 functional and interface clock
  CDC
    ACLK clkSource=SYST_ACLK clkDesc=CDC AXI master interface clock
    PCLK clkSource=SYST_PCLK clkDesc=CDC APB slave interface clock
    PIXEL_CLK clkSource=(SYST_ACLK or PLL_CLK3) / Div; (source selection and divider value can be configured in the CDC200_PIXCLK_CTRL[CLK_SEL][CLK_DIVISOR] register fields) clkDesc=CDC pixel data clock
  DSI
    LANEBYTECLK clkSource=D-PHY TX clkDesc=DSI lane byte clock
    PCLK clkSource=SYST_PCLK clkDesc=DSI APB slave interface clock
    RXCLKESC clkSource=D-PHY TX clkDesc=DSI RX escape clock
  D-PHYTX
    CFG_CLK clkSource=100M_CLK/4 clkDesc=D-PHY TX configuration clock (25 MHz)
    CLKEXT clkSource=PLL_CLK1 clkDesc=D-PHY TX PLL bypass clock (800 MHz)
    CLKIN clkSource=HFOSC_CLK clkDesc=D-PHY TX PLL reference clock (38.4 MHz)
    TXCLKESC clkSource=DSI clkDesc=DSI escape mode transmit clock
  ADC120
    PCLK clkSource=SYST_PCLK clkDesc=Functional and interface clock
  ADC121
    PCLK clkSource=SYST_PCLK clkDesc=Functional and interface clock
  ADC122
    PCLK clkSource=SYST_PCLK clkDesc=Functional and interface clock
  ADC24
    PCLK clkSource=SYST_PCLK clkDesc=Functional and interface clock
  CMP0
    PCLK clkSource=SYST_PCLK clkDesc=Register interface clock
  CMP1
    PCLK clkSource=SYST_PCLK clkDesc=Register interface clock
  CMP2
    PCLK clkSource=SYST_PCLK clkDesc=Register interface clock
  CMP3
    PCLK clkSource=SYST_PCLK clkDesc=Register interface clock
  LPCMP
    CLK32K clkSource=LFRC,LFXO clkDesc=LPCMP 32-kHz functional clock
  M55-HP
    CLKIN clkSource=RTSS_HP_CLK clkDesc=M55-HP functional and interface clock
  M55-HE
    CLKIN clkSource=RTSS_HE_CLK clkDesc=M55-HE functional and interface clock
  GPU2D
    CLK clkSource=SYST_ACLK clkDesc=Functional and AXI interface clock
  HWSEM
    PCLK clkSource=SYST_PCLK clkDesc=APB interface clock
  MHU_M55HE_A32_0_RX
    CLK clkSource=APSS_CLK clkDesc=Interface and functional clock
  MHU_A32_M55HE_0_TX
    CLK clkSource=APSS_CLK clkDesc=Interface and functional clock
  MHU_M55HE_A32_1_RX
    CLK clkSource=APSS_CLK clkDesc=Interface and functional clock
  MHU_A32_M55HE_1_TX
    CLK clkSource=APSS_CLK clkDesc=Interface and functional clock
  MHU_M55HP_A32_0_RX
    CLK clkSource=APSS_CLK clkDesc=Interface and functional clock
  MHU_A32_M55HP_0_TX
    CLK clkSource=APSS_CLK clkDesc=Interface and functional clock
  MHU_M55HP_A32_1_RX
    CLK clkSource=APSS_CLK clkDesc=Interface and functional clock
  MHU_A32_M55HP_1_TX
    CLK clkSource=APSS_CLK clkDesc=Interface and functional clock
  MHU_SECPU_A32_0_RX
    CLK clkSource=APSS_CLK clkDesc=Interface and functional clock
  MHU_A32_SECPU_0_TX
    CLK clkSource=APSS_CLK clkDesc=Interface and functional clock
  MHU_SECPU_A32_1_RX
    CLK clkSource=APSS_CLK clkDesc=Interface and functional clock
  MHU_A32_SECPU_1_TX
    CLK clkSource=APSS_CLK,APSS_CLK clkDesc=Interface and functional clock
  MHU_A32_M55HE_0_RX
    CLK clkSource=RTSS_HE_CLK clkDesc=Interface and functional clock
  MHU_M55HE_A32_0_TX
    CLK clkSource=RTSS_HE_CLK clkDesc=Interface and functional clock
  MHU_A32_M55HE_1_RX
    CLK clkSource=RTSS_HE_CLK clkDesc=Interface and functional clock
  MHU_M55HE_A32_1_TX
    CLK clkSource=RTSS_HE_CLK clkDesc=Interface and functional clock
  MHU_SECPU_M55HE_0_RX
    CLK clkSource=RTSS_HE_CLK clkDesc=Interface and functional clock
  MHU_M55HE_SECPU_0_TX
    CLK clkSource=RTSS_HE_CLK clkDesc=Interface and functional clock
  MHU_SECPU_M55HE_1_RX
    CLK clkSource=RTSS_HE_CLK clkDesc=Interface and functional clock
  MHU_M55HE_SECPU_1_TX
    CLK clkSource=RTSS_HE_CLK clkDesc=Interface and functional clock
  MHU_M55HP_M55HE_0_RX
    CLK clkSource=RTSS_HE_CLK clkDesc=Interface and functional clock
  MHU_M55HE_M55HP_0_TX
    CLK clkSource=RTSS_HE_CLK clkDesc=Interface and functional clock
  MHU_M55HP_M55HE_1_RX
    CLK clkSource=RTSS_HE_CLK clkDesc=Interface and functional clock
  MHU_M55HE_M55HP_1_TX
    CLK clkSource=RTSS_HE_CLK,RTSS_HE_CLK clkDesc=Interface and functional clock
  MHU_A32_M55HP_0_RX
    CLK clkSource=RTSS_HP_CLK clkDesc=Interface and functional clock
  MHU_M55HP_A32_0_TX
    CLK clkSource=RTSS_HP_CLK clkDesc=Interface and functional clock
  MHU_A32_M55HP_1_RX
    CLK clkSource=RTSS_HP_CLK clkDesc=Interface and functional clock
  MHU_M55HP_A32_1_TX
    CLK clkSource=RTSS_HP_CLK clkDesc=Interface and functional clock
  MHU_SECPU_M55HP_0_RX
    CLK clkSource=RTSS_HP_CLK clkDesc=Interface and functional clock
  MHU_M55HP_SECPU_0_TX
    CLK clkSource=RTSS_HP_CLK clkDesc=Interface and functional clock
  MHU_SECPU_M55HP_1_RX
    CLK clkSource=RTSS_HP_CLK clkDesc=Interface and functional clock
  MHU_M55HP_SECPU_1_TX
    CLK clkSource=RTSS_HP_CLK clkDesc=Interface and functional clock
  MHU_M55HE_M55HP_0_RX
    CLK clkSource=RTSS_HP_CLK clkDesc=Interface and functional clock
  MHU_M55HP_M55HE_0_TX
    CLK clkSource=RTSS_HP_CLK clkDesc=Interface and functional clock
  MHU_M55HE_M55HP_1_RX
    CLK clkSource=RTSS_HP_CLK clkDesc=Interface and functional clock
  MHU_M55HP_M55HE_1_TX
    CLK clkSource=RTSS_HP_CLK clkDesc=Interface and functional clock
